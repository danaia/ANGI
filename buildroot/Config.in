## buildroot/Config.in
```kconfig
source "$BR2_EXTERNAL_AGX_PATH/package/agx/Config.in"
source "$BR2_EXTERNAL_AGX_PATH/package/agx-gui/Config.in"
source "$BR2_EXTERNAL_AGX_PATH/package/agx-wayland/Config.in"
source "$BR2_EXTERNAL_AGX_PATH/package/agx-webkit/Config.in"
source "$BR2_EXTERNAL_AGX_PATH/package/agx-web/Config.in"
source "$BR2_EXTERNAL_AGX_PATH/package/agx-opencode/Config.in"
source "$BR2_EXTERNAL_AGX_PATH/package/agx-agent/Config.in"
source "$BR2_EXTERNAL_AGX_PATH/package/agx-cliamp/Config.in"
```

## buildroot/configs/agx_arm_desktop_defconfig
```kconfig
BR2_aarch64=y
BR2_TOOLCHAIN_EXTERNAL=y
BR2_TOOLCHAIN_EXTERNAL_BOOTLIN=y
BR2_GLOBAL_PATCH_DIR="board/aarch64-efi/patches"
BR2_DOWNLOAD_FORCE_CHECK_HASHES=y
BR2_PRIMARY_SITE="https://sources.buildroot.net"
BR2_SYSTEM_DHCP=""
BR2_TARGET_GENERIC_HOSTNAME="agx"
BR2_TARGET_GENERIC_ISSUE="ANGI"
BR2_TARGET_GENERIC_GETTY_PORT="tty1"
BR2_ROOTFS_POST_BUILD_SCRIPT="$(BR2_EXTERNAL_AGX_PATH)/board/agx/post-build.sh"
BR2_ROOTFS_POST_IMAGE_SCRIPT="$(BR2_EXTERNAL_AGX_PATH)/board/agx/uefi/post-image.sh"
BR2_ROOTFS_OVERLAY="$(BR2_EXTERNAL_AGX_PATH)/board/agx/rootfs-overlay"
BR2_ROOTFS_DEVICE_TABLE="system/device_table.txt $(BR2_EXTERNAL_AGX_PATH)/board/agx/permissions.txt"
BR2_LINUX_KERNEL=y
BR2_LINUX_KERNEL_CUSTOM_VERSION=y
BR2_LINUX_KERNEL_CUSTOM_VERSION_VALUE="6.18.14"
BR2_LINUX_KERNEL_CONFIG_FRAGMENT_FILES="$(BR2_EXTERNAL_AGX_PATH)/board/agx/uefi/linux.fragment"
BR2_LINUX_KERNEL_NEEDS_HOST_OPENSSL=y
BR2_LINUX_KERNEL_USE_ARCH_DEFAULT_CONFIG=y
BR2_LINUX_KERNEL_NEEDS_HOST_PYTHON3=y
BR2_TOOLCHAIN_EXTERNAL_BOOTLIN_AARCH64_GLIBC_STABLE=y
BR2_TARGET_GRUB2_ARM64_EFI=y
BR2_TARGET_ROOTFS_EXT2=y
BR2_TARGET_ROOTFS_EXT2_4=y
BR2_TARGET_ROOTFS_EXT2_SIZE="512M"
BR2_TARGET_GRUB2=y
BR2_TARGET_GRUB2_BOOT_PARTITION="hd0,gpt1"
BR2_TARGET_GRUB2_BUILTIN_MODULES_EFI="boot linux ext2 fat part_gpt normal efi_gop search search_fs_file"
BR2_PACKAGE_HOST_DOSFSTOOLS=y
BR2_PACKAGE_HOST_GENIMAGE=y
BR2_PACKAGE_HOST_MTOOLS=y
BR2_PACKAGE_AGX=y
BR2_PACKAGE_DROPBEAR=y
BR2_PACKAGE_KMOD=y
BR2_PACKAGE_KMOD_TOOLS=y
BR2_PACKAGE_LINUX_FIRMWARE=y
BR2_PACKAGE_LINUX_FIRMWARE_IWLWIFI_9XXX=y
BR2_PACKAGE_LINUX_FIRMWARE_RTL_8169=y
BR2_PACKAGE_WIRELESS_REGDB=y
BR2_PACKAGE_IW=y
BR2_PACKAGE_WPA_SUPPLICANT=y
BR2_PACKAGE_WPA_SUPPLICANT_NL80211=y
BR2_PACKAGE_WPA_SUPPLICANT_CTRL_IFACE=y
BR2_PACKAGE_WPA_SUPPLICANT_CLI=y
BR2_PACKAGE_WPA_SUPPLICANT_WPA3=y
BR2_PACKAGE_CA_CERTIFICATES=y
BR2_PACKAGE_LIBCURL=y
BR2_PACKAGE_LIBCURL_CURL=y
BR2_PACKAGE_LIBCURL_OPENSSL=y
BR2_PACKAGE_BUSYBOX_CONFIG_FRAGMENT_FILES="$(BR2_EXTERNAL_AGX_PATH)/board/agx/busybox-network.fragment"
BR2_PACKAGE_E2FSPROGS=y
BR2_PACKAGE_UTIL_LINUX=y
BR2_PACKAGE_UTIL_LINUX_BINARIES=y
BR2_PACKAGE_UTIL_LINUX_WIPEFS=y
```

## buildroot/configs/agx_rpizero2w_defconfig
```kconfig
# Based on Buildroot 2026.08.1 raspberrypizero2w_64_defconfig.
BR2_aarch64=y
BR2_cortex_a53=y
BR2_TOOLCHAIN_EXTERNAL=y
BR2_TOOLCHAIN_EXTERNAL_BOOTLIN=y
BR2_TOOLCHAIN_EXTERNAL_BOOTLIN_AARCH64_GLIBC_STABLE=y
BR2_GLOBAL_PATCH_DIR="board/raspberrypi/patches $(BR2_EXTERNAL_AGX_PATH)/board/agx/patches"
BR2_DOWNLOAD_FORCE_CHECK_HASHES=y
BR2_PRIMARY_SITE="https://sources.buildroot.net"
BR2_SYSTEM_DHCP=""
BR2_ROOTFS_POST_BUILD_SCRIPT="board/raspberrypizero2w-64/post-build.sh $(BR2_EXTERNAL_AGX_PATH)/board/agx/post-build.sh"
BR2_ROOTFS_POST_IMAGE_SCRIPT="support/scripts/genimage.sh"
BR2_ROOTFS_POST_SCRIPT_ARGS="-c $(BR2_EXTERNAL_AGX_PATH)/board/agx/rpizero2w/genimage.cfg"
BR2_LINUX_KERNEL=y
BR2_LINUX_KERNEL_CUSTOM_TARBALL=y
BR2_LINUX_KERNEL_CUSTOM_TARBALL_LOCATION="$(call github,raspberrypi,linux,21b410140c47ffab5668399f6f143c7d7b935c8b)/linux-21b410140c47ffab5668399f6f143c7d7b935c8b.tar.gz"
BR2_LINUX_KERNEL_DEFCONFIG="bcm2711"
BR2_LINUX_KERNEL_CONFIG_FRAGMENT_FILES="$(BR2_EXTERNAL_AGX_PATH)/board/agx/linux-usb-gadget.fragment $(BR2_EXTERNAL_AGX_PATH)/board/agx/rpizero2w/linux.fragment"
BR2_LINUX_KERNEL_DTS_SUPPORT=y
BR2_LINUX_KERNEL_INTREE_DTS_NAME="broadcom/bcm2710-rpi-zero-2-w"
BR2_LINUX_KERNEL_NEEDS_HOST_OPENSSL=y
BR2_PACKAGE_BUSYBOX_SHOW_OTHERS=y
BR2_PACKAGE_XZ=y
BR2_PACKAGE_RPI_FIRMWARE=y
BR2_PACKAGE_RPI_FIRMWARE_BOOTCODE_BIN=y
BR2_PACKAGE_RPI_FIRMWARE_VARIANT_PI=y
BR2_PACKAGE_RPI_FIRMWARE_VARIANT_PI_CD=y
BR2_PACKAGE_RPI_FIRMWARE_CONFIG_FILE="$(BR2_EXTERNAL_AGX_PATH)/board/agx/rpizero2w/config.txt"
BR2_PACKAGE_RPI_FIRMWARE_CMDLINE_FILE="$(BR2_EXTERNAL_AGX_PATH)/board/agx/rpizero2w/cmdline.txt"
BR2_PACKAGE_RPI_FIRMWARE_INSTALL_DTB_OVERLAYS=y
BR2_PACKAGE_KMOD=y
BR2_PACKAGE_KMOD_TOOLS=y
BR2_TARGET_ROOTFS_EXT2=y
BR2_TARGET_ROOTFS_EXT2_4=y
BR2_TARGET_ROOTFS_EXT2_SIZE="1024M"
# BR2_TARGET_ROOTFS_TAR is not set
BR2_PACKAGE_HOST_DOSFSTOOLS=y
BR2_PACKAGE_HOST_GENIMAGE=y
BR2_PACKAGE_HOST_KMOD_XZ=y
BR2_PACKAGE_HOST_MTOOLS=y
BR2_TARGET_GENERIC_HOSTNAME="angi-zero"
BR2_TARGET_GENERIC_ISSUE="ANGI"
BR2_TARGET_GENERIC_GETTY_PORT="ttyAMA0"
BR2_TARGET_GENERIC_GETTY_BAUDRATE_115200=y
BR2_ROOTFS_OVERLAY="$(BR2_EXTERNAL_AGX_PATH)/board/agx/rootfs-overlay $(BR2_EXTERNAL_AGX_PATH)/board/agx/rpizero2w/rootfs-overlay"
BR2_ROOTFS_DEVICE_TABLE="system/device_table.txt $(BR2_EXTERNAL_AGX_PATH)/board/agx/permissions.txt"
BR2_REPRODUCIBLE=y
BR2_PACKAGE_DROPBEAR=y
# BR2_PACKAGE_DROPBEAR_CLIENT is not set
BR2_PACKAGE_AGX=y
BR2_PACKAGE_BRCMFMAC_SDIO_FIRMWARE_RPI=y
BR2_PACKAGE_BRCMFMAC_SDIO_FIRMWARE_RPI_WIFI=y
BR2_PACKAGE_WIRELESS_REGDB=y
BR2_PACKAGE_IW=y
BR2_PACKAGE_WPA_SUPPLICANT=y
BR2_PACKAGE_WPA_SUPPLICANT_NL80211=y
BR2_PACKAGE_WPA_SUPPLICANT_CTRL_IFACE=y
BR2_PACKAGE_WPA_SUPPLICANT_CLI=y
BR2_PACKAGE_WPA_SUPPLICANT_WPA3=y
BR2_PACKAGE_CA_CERTIFICATES=y
BR2_PACKAGE_LIBCURL=y
BR2_PACKAGE_LIBCURL_CURL=y
BR2_PACKAGE_LIBCURL_OPENSSL=y
BR2_PACKAGE_BUSYBOX_CONFIG_FRAGMENT_FILES="$(BR2_EXTERNAL_AGX_PATH)/board/agx/busybox-network.fragment $(BR2_EXTERNAL_AGX_PATH)/board/agx/rpizero2w/busybox.fragment"

# Filesystem tools for AGX data volumes.
BR2_PACKAGE_E2FSPROGS=y

# The shared Pebble Line desktop on a software framebuffer over loopback VNC.
BR2_PACKAGE_FONTCONFIG=y
BR2_PACKAGE_DEJAVU=y
BR2_PACKAGE_DEJAVU_SANS=y
# BR2_PACKAGE_DEJAVU_MONO is not set
# BR2_PACKAGE_DEJAVU_SERIF is not set
# BR2_PACKAGE_DEJAVU_SANS_CONDENSED is not set
# BR2_PACKAGE_DEJAVU_SERIF_CONDENSED is not set
BR2_PACKAGE_AGX_GUI=y
BR2_PACKAGE_AGX_GUI_HEADLESS=y
BR2_PACKAGE_BASH=y
BR2_PACKAGE_OPENSSH=y
BR2_PACKAGE_OPENSSH_CLIENT=y
# BR2_PACKAGE_OPENSSH_SERVER is not set
```

## buildroot/configs/agx_x86_amd_defconfig
```kconfig
BR2_x86_64=y
BR2_TOOLCHAIN_EXTERNAL=y
BR2_TOOLCHAIN_EXTERNAL_BOOTLIN=y
BR2_GLOBAL_PATCH_DIR="board/pc/patches"
BR2_DOWNLOAD_FORCE_CHECK_HASHES=y
BR2_PRIMARY_SITE="https://sources.buildroot.net"
BR2_SYSTEM_DHCP=""
BR2_TARGET_GENERIC_HOSTNAME="agx"
BR2_TARGET_GENERIC_ISSUE="ANGI"
BR2_TARGET_GENERIC_GETTY_PORT="tty1"
BR2_ROOTFS_POST_BUILD_SCRIPT="$(BR2_EXTERNAL_AGX_PATH)/board/agx/post-build.sh"
BR2_ROOTFS_POST_IMAGE_SCRIPT="$(BR2_EXTERNAL_AGX_PATH)/board/agx/uefi/post-image.sh"
BR2_ROOTFS_OVERLAY="$(BR2_EXTERNAL_AGX_PATH)/board/agx/rootfs-overlay"
BR2_ROOTFS_DEVICE_TABLE="system/device_table.txt $(BR2_EXTERNAL_AGX_PATH)/board/agx/permissions.txt"
BR2_LINUX_KERNEL=y
BR2_LINUX_KERNEL_CUSTOM_VERSION=y
BR2_LINUX_KERNEL_CUSTOM_VERSION_VALUE="6.12.47"
BR2_LINUX_KERNEL_CONFIG_FRAGMENT_FILES="$(BR2_EXTERNAL_AGX_PATH)/board/agx/uefi/linux.fragment $(BR2_EXTERNAL_AGX_PATH)/board/agx/uefi/x86.fragment $(BR2_EXTERNAL_AGX_PATH)/board/agx/uefi/x86-hardware.fragment $(BR2_EXTERNAL_AGX_PATH)/board/agx/uefi/x86-amd.fragment"
BR2_LINUX_KERNEL_NEEDS_HOST_OPENSSL=y
BR2_LINUX_KERNEL_USE_CUSTOM_CONFIG=y
BR2_LINUX_KERNEL_CUSTOM_CONFIG_FILE="board/pc/linux.config"
BR2_LINUX_KERNEL_NEEDS_HOST_LIBELF=y
BR2_TOOLCHAIN_EXTERNAL_BOOTLIN_X86_64_GLIBC_STABLE=y
BR2_TARGET_GRUB2_X86_64_EFI=y
BR2_TARGET_ROOTFS_EXT2=y
BR2_TARGET_ROOTFS_EXT2_4=y
BR2_TARGET_ROOTFS_EXT2_SIZE="2G"
BR2_TARGET_GRUB2=y
BR2_TARGET_GRUB2_BOOT_PARTITION="hd0,gpt1"
BR2_TARGET_GRUB2_BUILTIN_MODULES_EFI="boot linux ext2 fat part_gpt normal efi_gop search search_fs_file"
BR2_PACKAGE_HOST_DOSFSTOOLS=y
BR2_PACKAGE_HOST_GENIMAGE=y
BR2_PACKAGE_HOST_MTOOLS=y
BR2_PACKAGE_AGX=y
BR2_PACKAGE_DROPBEAR=y
# OpenSSH client and key utilities: Settings -> Security reads and pins the connected computer's host key.
BR2_PACKAGE_OPENSSH=y
BR2_PACKAGE_OPENSSH_CLIENT=y
# BR2_PACKAGE_OPENSSH_SERVER is not set
BR2_PACKAGE_OPENSSH_KEY_UTILS=y
BR2_PACKAGE_BUSYBOX_SHOW_OTHERS=y
BR2_PACKAGE_KMOD=y
BR2_PACKAGE_KMOD_TOOLS=y
BR2_PACKAGE_LINUX_FIRMWARE=y
BR2_PACKAGE_LINUX_FIRMWARE_IWLWIFI_9XXX=y
BR2_PACKAGE_LINUX_FIRMWARE_IWLWIFI_22000=y
BR2_PACKAGE_LINUX_FIRMWARE_IWLWIFI_22260=y
BR2_PACKAGE_LINUX_FIRMWARE_IWLWIFI_6E=y
BR2_PACKAGE_LINUX_FIRMWARE_IWLWIFI_7=y
BR2_PACKAGE_LINUX_FIRMWARE_MEDIATEK_MT7921=y
BR2_PACKAGE_LINUX_FIRMWARE_MEDIATEK_MT7922=y
BR2_PACKAGE_LINUX_FIRMWARE_RTL_RTW88=y
BR2_PACKAGE_LINUX_FIRMWARE_RTL_RTW89=y
BR2_PACKAGE_LINUX_FIRMWARE_RTL_815X=y
BR2_PACKAGE_LINUX_FIRMWARE_RTL_8169=y
BR2_PACKAGE_LINUX_FIRMWARE_ATHEROS_7010=y
BR2_PACKAGE_LINUX_FIRMWARE_ATHEROS_9271=y
BR2_PACKAGE_LINUX_FIRMWARE_ATHEROS_10K_QCA9377=y
BR2_PACKAGE_LINUX_FIRMWARE_ATHEROS_10K_QCA998X=y
BR2_PACKAGE_LINUX_FIRMWARE_QUALCOMM_6174=y
BR2_PACKAGE_LINUX_FIRMWARE_ATHEROS_11K_WCN6855=y
BR2_PACKAGE_LINUX_FIRMWARE_QUALCOMM_WCN7850=y
BR2_PACKAGE_LINUX_FIRMWARE_BRCM_BCM43XX=y
BR2_PACKAGE_LINUX_FIRMWARE_BRCM_BCM43XXX=y
BR2_PACKAGE_LINUX_FIRMWARE_BRCM_BCM4366C0=y
BR2_PACKAGE_LINUX_FIRMWARE_MEDIATEK_MT7601U=y
BR2_PACKAGE_LINUX_FIRMWARE_MEDIATEK_MT7610E=y
BR2_PACKAGE_LINUX_FIRMWARE_MEDIATEK_MT76X2E=y
BR2_PACKAGE_LINUX_FIRMWARE_MEDIATEK_MT7916=y
BR2_PACKAGE_LINUX_FIRMWARE_MEDIATEK_MT7920=y
BR2_PACKAGE_LINUX_FIRMWARE_MEDIATEK_MT7925=y
BR2_PACKAGE_LINUX_FIRMWARE_RALINK_RT2XX=y
BR2_PACKAGE_LINUX_FIRMWARE_RTL_87XX=y
BR2_PACKAGE_LINUX_FIRMWARE_RTL_88XX=y
BR2_PACKAGE_LINUX_FIRMWARE_BROADCOM_TIGON3=y
BR2_PACKAGE_LINUX_FIRMWARE_BNX2=y
BR2_PACKAGE_LINUX_FIRMWARE_INTEL_E100=y
BR2_PACKAGE_WIRELESS_REGDB=y
BR2_PACKAGE_IW=y
BR2_PACKAGE_WPA_SUPPLICANT=y
BR2_PACKAGE_WPA_SUPPLICANT_NL80211=y
BR2_PACKAGE_WPA_SUPPLICANT_CTRL_IFACE=y
BR2_PACKAGE_WPA_SUPPLICANT_CLI=y
BR2_PACKAGE_WPA_SUPPLICANT_WPA3=y
BR2_PACKAGE_CA_CERTIFICATES=y
BR2_PACKAGE_LIBCURL=y
BR2_PACKAGE_LIBCURL_CURL=y
BR2_PACKAGE_LIBCURL_OPENSSL=y
BR2_PACKAGE_BUSYBOX_CONFIG_FRAGMENT_FILES="$(BR2_EXTERNAL_AGX_PATH)/board/agx/busybox-network.fragment"
BR2_PACKAGE_E2FSPROGS=y
BR2_PACKAGE_UTIL_LINUX=y
BR2_PACKAGE_UTIL_LINUX_BINARIES=y
BR2_PACKAGE_UTIL_LINUX_WIPEFS=y
BR2_PACKAGE_LIBUDEV_ZERO=y
BR2_PACKAGE_LIBINPUT=y
BR2_PACKAGE_LIBXKBCOMMON=y
BR2_PACKAGE_XKEYBOARD_CONFIG=y
BR2_PACKAGE_FONTCONFIG=y
BR2_PACKAGE_LIBDRM=y
BR2_PACKAGE_AGX_GUI_PROVISION_GRAPHICS=y
BR2_PACKAGE_AGX_GUI=y
BR2_PACKAGE_AGX_AGENT=y
BR2_STRIP_EXCLUDE_FILES="opencode"
BR2_PACKAGE_MESA3D=y
BR2_PACKAGE_MESA3D_GALLIUM_DRIVER_SOFTPIPE=y
BR2_PACKAGE_MESA3D_OPENGL_EGL=y
BR2_PACKAGE_MESA3D_OPENGL_ES=y
BR2_PACKAGE_MESA3D_GBM=y
BR2_PACKAGE_AGX_WEB=y
BR2_PACKAGE_AGX_WEB_SD_STORAGE=y
BR2_PACKAGE_DBUS=y
BR2_PACKAGE_BLUEZ5_UTILS=y
BR2_PACKAGE_BLUEZ5_UTILS_CLIENT=y
BR2_PACKAGE_BLUEZ5_UTILS_PLUGINS_HID=y
BR2_PACKAGE_SBC=y
BR2_PACKAGE_ALSA_UTILS=y
BR2_PACKAGE_ALSA_UTILS_APLAY=y
BR2_PACKAGE_PULSEAUDIO=y
BR2_PACKAGE_PULSEAUDIO_DAEMON=y
```

## buildroot/configs/agx_x86_desktop_defconfig
```kconfig
BR2_x86_64=y
BR2_TOOLCHAIN_EXTERNAL=y
BR2_TOOLCHAIN_EXTERNAL_BOOTLIN=y
BR2_GLOBAL_PATCH_DIR="board/pc/patches"
BR2_DOWNLOAD_FORCE_CHECK_HASHES=y
BR2_PRIMARY_SITE="https://sources.buildroot.net"
BR2_SYSTEM_DHCP=""
BR2_TARGET_GENERIC_HOSTNAME="agx"
BR2_TARGET_GENERIC_ISSUE="ANGI"
BR2_TARGET_GENERIC_GETTY_PORT="tty1"
BR2_ROOTFS_POST_BUILD_SCRIPT="$(BR2_EXTERNAL_AGX_PATH)/board/agx/post-build.sh"
BR2_ROOTFS_POST_IMAGE_SCRIPT="$(BR2_EXTERNAL_AGX_PATH)/board/agx/uefi/post-image.sh"
BR2_ROOTFS_OVERLAY="$(BR2_EXTERNAL_AGX_PATH)/board/agx/rootfs-overlay"
BR2_ROOTFS_DEVICE_TABLE="system/device_table.txt $(BR2_EXTERNAL_AGX_PATH)/board/agx/permissions.txt"
BR2_LINUX_KERNEL=y
BR2_LINUX_KERNEL_CUSTOM_VERSION=y
BR2_LINUX_KERNEL_CUSTOM_VERSION_VALUE="6.12.47"
BR2_LINUX_KERNEL_CONFIG_FRAGMENT_FILES="$(BR2_EXTERNAL_AGX_PATH)/board/agx/uefi/linux.fragment"
BR2_LINUX_KERNEL_NEEDS_HOST_OPENSSL=y
BR2_LINUX_KERNEL_USE_CUSTOM_CONFIG=y
BR2_LINUX_KERNEL_CUSTOM_CONFIG_FILE="board/pc/linux.config"
BR2_LINUX_KERNEL_NEEDS_HOST_LIBELF=y
BR2_TOOLCHAIN_EXTERNAL_BOOTLIN_X86_64_GLIBC_STABLE=y
BR2_TARGET_GRUB2_X86_64_EFI=y
BR2_TARGET_ROOTFS_EXT2=y
BR2_TARGET_ROOTFS_EXT2_4=y
BR2_TARGET_ROOTFS_EXT2_SIZE="512M"
BR2_TARGET_GRUB2=y
BR2_TARGET_GRUB2_BOOT_PARTITION="hd0,gpt1"
BR2_TARGET_GRUB2_BUILTIN_MODULES_EFI="boot linux ext2 fat part_gpt normal efi_gop search search_fs_file"
BR2_PACKAGE_HOST_DOSFSTOOLS=y
BR2_PACKAGE_HOST_GENIMAGE=y
BR2_PACKAGE_HOST_MTOOLS=y
BR2_PACKAGE_AGX=y
BR2_PACKAGE_DROPBEAR=y
# OpenSSH client and key utilities: Settings -> Security reads and pins the connected computer's host key.
BR2_PACKAGE_OPENSSH=y
BR2_PACKAGE_OPENSSH_CLIENT=y
# BR2_PACKAGE_OPENSSH_SERVER is not set
BR2_PACKAGE_OPENSSH_KEY_UTILS=y
BR2_PACKAGE_KMOD=y
BR2_PACKAGE_KMOD_TOOLS=y
BR2_PACKAGE_LINUX_FIRMWARE=y
BR2_PACKAGE_LINUX_FIRMWARE_IWLWIFI_9XXX=y
BR2_PACKAGE_LINUX_FIRMWARE_RTL_8169=y
BR2_PACKAGE_WIRELESS_REGDB=y
BR2_PACKAGE_IW=y
BR2_PACKAGE_WPA_SUPPLICANT=y
BR2_PACKAGE_WPA_SUPPLICANT_NL80211=y
BR2_PACKAGE_WPA_SUPPLICANT_CTRL_IFACE=y
BR2_PACKAGE_WPA_SUPPLICANT_CLI=y
BR2_PACKAGE_WPA_SUPPLICANT_WPA3=y
BR2_PACKAGE_CA_CERTIFICATES=y
BR2_PACKAGE_LIBCURL=y
BR2_PACKAGE_LIBCURL_CURL=y
BR2_PACKAGE_LIBCURL_OPENSSL=y
BR2_PACKAGE_BUSYBOX_CONFIG_FRAGMENT_FILES="$(BR2_EXTERNAL_AGX_PATH)/board/agx/busybox-network.fragment"
BR2_PACKAGE_E2FSPROGS=y
BR2_PACKAGE_UTIL_LINUX=y
BR2_PACKAGE_UTIL_LINUX_BINARIES=y
BR2_PACKAGE_UTIL_LINUX_WIPEFS=y
```

## buildroot/package/agx-agent/Config.in
```kconfig
config BR2_PACKAGE_AGX_AGENT
	bool "ANGI Herdr development swarm"
	depends on BR2_aarch64
	depends on BR2_TOOLCHAIN_USES_GLIBC
	depends on BR2_USE_MMU
	depends on BR2_USE_WCHAR
	depends on BR2_TOOLCHAIN_HAS_THREADS
	depends on !BR2_STATIC_LIBS
	depends on BR2_PACKAGE_HOST_RUSTC_TARGET_ARCH_SUPPORTS
	select BR2_PACKAGE_AGX_OPENCODE
	select BR2_PACKAGE_PYTHON3
	select BR2_PACKAGE_PYTHON3_CURSES
	select BR2_PACKAGE_PYTHON3_SQLITE
	select BR2_PACKAGE_PYTHON3_ZLIB
	help
	  Herdr with three OpenCode roles, a build-brief TUI and admin helper.
	  Native development SDK and source are provisioned separately on NVMe.
```

## buildroot/package/agx-cliamp/Config.in
```kconfig
config BR2_PACKAGE_AGX_CLIAMP
	bool "CLIamp radio player for ANGI"
	depends on BR2_aarch64
	depends on BR2_TOOLCHAIN_USES_GLIBC
	select BR2_PACKAGE_ALSA_LIB
	select BR2_PACKAGE_CA_CERTIFICATES
	help
	  CLIamp is a terminal music player. A bare launch plays Radio Paradise.
```

## buildroot/package/agx-gui/Config.in
```kconfig
config BR2_PACKAGE_AGX_GUI
	bool "ANGI desktop"
	depends on BR2_PACKAGE_AGX
	depends on BR2_PACKAGE_FONTCONFIG
	depends on BR2_PACKAGE_AGX_GUI_HEADLESS || (BR2_PACKAGE_LIBINPUT && BR2_PACKAGE_LIBXKBCOMMON && BR2_PACKAGE_LIBDRM && (BR2_PACKAGE_AGX_GUI_PROVISION_GRAPHICS || (BR2_PACKAGE_MESA3D_GBM && BR2_PACKAGE_HAS_LIBEGL && BR2_PACKAGE_HAS_LIBGLES)))
	depends on BR2_PACKAGE_AGX_GUI_HEADLESS || BR2_PACKAGE_XKEYBOARD_CONFIG
	help
	  ANGI desktop with HDMI graphics and a headless VNC display.

config BR2_PACKAGE_AGX_GUI_HEADLESS
	bool "Build ANGI desktop for software VNC only"
	depends on BR2_PACKAGE_AGX
	help
	  Build the desktop without HDMI graphics libraries for small headless devices.


config BR2_PACKAGE_AGX_GUI_PROVISION_GRAPHICS
	bool "Download graphics drivers during ANGI setup"
	depends on BR2_x86_64 && BR2_PACKAGE_AGX && !BR2_PACKAGE_AGX_GUI_HEADLESS
	help
	  Start the desktop with a framebuffer and load hardware graphics
	  libraries only after the signed driver bundle is installed.
```
