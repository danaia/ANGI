## buildroot/package/agx-opencode/Config.in
```kconfig
config BR2_PACKAGE_AGX_OPENCODE
	bool "OpenCode CLI for ANGI"
	depends on BR2_aarch64 || BR2_x86_64
	depends on BR2_USE_MMU
	depends on BR2_TOOLCHAIN_USES_GLIBC
	depends on BR2_PACKAGE_HOST_RUSTC_TARGET_ARCH_SUPPORTS
	select BR2_PACKAGE_BASH
	select BR2_PACKAGE_GIT
	select BR2_PACKAGE_RIPGREP
	select BR2_PACKAGE_CA_CERTIFICATES
	help
	  Pinned official OpenCode terminal coding agent, with Git and ripgrep.
	  User data and caches are stored privately on the ANGI data volume,
	  or in the account's home directory on x86-64 without a data volume.
```

## buildroot/package/agx-wayland/Config.in
```kconfig
config BR2_PACKAGE_AGX_WAYLAND
	bool "ANGI Wayland desktop"
	depends on BR2_PACKAGE_AGX
	depends on BR2_PACKAGE_HAS_LIBUDEV && BR2_PACKAGE_LIBINPUT
	depends on BR2_PACKAGE_LIBXKBCOMMON
	depends on BR2_PACKAGE_HAS_LIBEGL && BR2_PACKAGE_HAS_LIBGBM && BR2_PACKAGE_HAS_LIBGLES
	depends on BR2_INSTALL_LIBSTDCPP && BR2_USE_MMU
	depends on BR2_TOOLCHAIN_HAS_THREADS && !BR2_STATIC_LIBS
	depends on BR2_TOOLCHAIN_HEADERS_AT_LEAST_3_0
	depends on !BR2_PACKAGE_WESTON
	depends on BR2_PACKAGE_WAYLAND
	select BR2_PACKAGE_WAYLAND_PROTOCOLS
	select BR2_PACKAGE_LIBDISPLAY_INFO
	select BR2_PACKAGE_CAIRO
	select BR2_PACKAGE_CAIRO_PNG
	select BR2_PACKAGE_LIBPNG
	select BR2_PACKAGE_SEATD
	select BR2_PACKAGE_SEATD_DAEMON
	select BR2_PACKAGE_XKEYBOARD_CONFIG
	select BR2_PACKAGE_ZLIB
	help
	  Build the native Wayland desktop with Weston using ANGI's
	  libudev provider. Enable the graphical ANGI desktop as well to
	  run its shell with hardware acceleration on HDMI.
```

## buildroot/package/agx-web/Config.in
```kconfig
config BR2_PACKAGE_AGX_WEB
	bool "ANGI Web application"
	depends on BR2_aarch64 || BR2_x86_64
	depends on BR2_INSTALL_LIBSTDCPP
	depends on BR2_USE_WCHAR
	depends on BR2_TOOLCHAIN_HAS_THREADS_NPTL
	depends on !BR2_STATIC_LIBS
	depends on BR2_PACKAGE_HAS_LIBEGL
	depends on BR2_PACKAGE_HAS_LIBGLES
	select BR2_PACKAGE_AGX_WEBKIT
	help
	  Lightweight WPEPlatform embedding host for the ANGI desktop.
	  Launched on demand by the GUI's Web app.

config BR2_PACKAGE_AGX_WEB_SD_STORAGE
	bool "Allow browser storage on the system card"
	depends on BR2_PACKAGE_AGX_WEB
	help
	  Use private per-account storage when no separate data volume is mounted.
```

## buildroot/package/agx-webkit/Config.in
```kconfig
config BR2_PACKAGE_AGX_WEBKIT
	bool "ANGI embedded web engine"
	depends on BR2_aarch64 || BR2_x86_64
	depends on BR2_INSTALL_LIBSTDCPP
	depends on BR2_USE_WCHAR
	depends on BR2_TOOLCHAIN_HAS_THREADS_NPTL
	depends on !BR2_STATIC_LIBS
	depends on BR2_PACKAGE_HAS_LIBEGL
	depends on BR2_PACKAGE_HAS_LIBGLES
	select BR2_HOST_CMAKE_AT_LEAST_3_20
	select BR2_PACKAGE_LIBGLIB2
	select BR2_PACKAGE_FONTCONFIG
	select BR2_PACKAGE_FREETYPE
	select BR2_PACKAGE_HARFBUZZ
	select BR2_PACKAGE_ICU
	select BR2_PACKAGE_JPEG
	select BR2_PACKAGE_LIBEPOXY
	select BR2_PACKAGE_LIBGCRYPT
	select BR2_PACKAGE_LIBSOUP3
	select BR2_PACKAGE_LIBSOUP3_SSL
	select BR2_PACKAGE_LIBTASN1
	select BR2_PACKAGE_LIBXML2
	select BR2_PACKAGE_LIBPNG
	select BR2_PACKAGE_SQLITE
	select BR2_PACKAGE_WEBP
	select BR2_PACKAGE_WEBP_DEMUX
	select BR2_PACKAGE_WEBP_MUX
	select BR2_PACKAGE_WOFF2
	select BR2_PACKAGE_LIBINPUT
	select BR2_PACKAGE_LIBXKBCOMMON
	select BR2_PACKAGE_LIBSECCOMP
	select BR2_PACKAGE_BUBBLEWRAP
	select BR2_PACKAGE_XDG_DBUS_PROXY
	select BR2_PACKAGE_CA_CERTIFICATES
	select BR2_PACKAGE_SHARED_MIME_INFO
	select BR2_PACKAGE_DEJAVU
	help
	  Sandboxed WPE WebKit 2.54 with the stable WPEPlatform API.
	  ANGI embeds web content inside its existing window system;
	  Chromium, Cog and a Wayland compositor are not required.
```
